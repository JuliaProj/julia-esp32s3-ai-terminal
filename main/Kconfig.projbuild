## main/Kconfig.projbuild
```kconfig
menu "Julia robot configuration"

config JULIA_WIFI_SSID
    string "Wi-Fi SSID"
    default ""
config JULIA_WIFI_PASSWORD
    string "Wi-Fi password"
    default ""
config JULIA_FIRMWARE_VERSION
    string "Firmware version"
    default "0.8.0"
config JULIA_OTA_URL
    string "Default OTA URL"
    default ""
config JULIA_DIAGNOSTIC_PERIOD_SECONDS
    int "Diagnostic period in seconds"
    range 10 3600
    default 60

choice JULIA_HOME_BACKEND
    prompt "Home control backend"
    default JULIA_HOME_BACKEND_VIRTUAL
config JULIA_HOME_BACKEND_VIRTUAL
    bool "Virtual"
config JULIA_HOME_BACKEND_HA
    bool "Home Assistant"
endchoice
config JULIA_HA_URL
    string "Home Assistant URL"
    default ""
config JULIA_HA_TOKEN
    string "Home Assistant token"
    default ""

config JULIA_AI_API_KEY
    string "Cloud AI API key"
    default ""
config JULIA_AI_MODEL
    string "Cloud AI model"
    default "qwen3.7-plus"
config JULIA_DASHSCOPE_FALLBACK_IP
    string "DashScope fallback IPv4"
    default "8.152.159.24"
config JULIA_AI_TEST_ON_BOOT
    bool "Run AI test on boot"
    default n
config JULIA_VOICE_PLAYBACK_SELF_TEST
    bool "Run voice playback self-test"
    default n

config JULIA_SOAK_TEST
    bool "Enable silent event-injection soak test"
    default y
    help
        Disable for production firmware to remove all soak code and runtime data.

endmenu
```

## sdkconfig.defaults
```kconfig
# ESP32-S3 target defaults for julia-ai
CONFIG_IDF_TARGET="esp32s3"
CONFIG_ESPTOOLPY_FLASHSIZE_16MB=y
CONFIG_SPIRAM=y
CONFIG_SPIRAM_MODE_OCT=y
CONFIG_SPIRAM_TYPE_AUTO=y
CONFIG_SPIRAM_SPEED_80M=y
CONFIG_SPIRAM_USE_MALLOC=y
CONFIG_SPIRAM_MALLOC_ALWAYSINTERNAL=0
CONFIG_SPIRAM_MALLOC_RESERVE_INTERNAL=32768
CONFIG_FREERTOS_USE_TRACE_FACILITY=y
CONFIG_FREERTOS_IDLE_TASK_STACKSIZE=2304
CONFIG_ESP_IPC_TASK_STACK_SIZE=2048
CONFIG_ESP_SYSTEM_EVENT_TASK_STACK_SIZE=3200
CONFIG_ESP_MAIN_TASK_STACK_SIZE=5120
CONFIG_ESP_TASK_WDT_PANIC=y
CONFIG_ESP_TASK_WDT_TIMEOUT_S=10
CONFIG_JULIA_SOAK_TEST=y
CONFIG_LV_IMG_CACHE_DEF_SIZE=12
CONFIG_ESP_DEFAULT_CPU_FREQ_MHZ_240=y
CONFIG_ESP32S3_DATA_CACHE_64KB=y
CONFIG_ESP32S3_DATA_CACHE_LINE_64B=y
CONFIG_BOOTLOADER_LOG_LEVEL_WARN=y
CONFIG_COMPILER_OPTIMIZATION_SIZE=y
CONFIG_LOG_DEFAULT_LEVEL_INFO=y
CONFIG_LV_CONF_SKIP=y
CONFIG_LV_COLOR_DEPTH_16=y
CONFIG_LV_COLOR_CHROMA_KEY_HEX=0xFF00FF
CONFIG_LV_COLOR_16_SWAP=y
CONFIG_USE_AFE=y
CONFIG_AFE_INTERFACE_V1=y
CONFIG_USE_WAKENET=y
CONFIG_SR_WN_WN9_NIHAOXIAOZHI_TTS=y
CONFIG_SR_MN_CN_MULTINET7_QUANT=y
CONFIG_SR_MN_EN_NONE=y
CONFIG_LV_BUILD_EXAMPLES=n
CONFIG_LV_USE_DEMO_WIDGETS=n
CONFIG_LV_USE_DEMO_KEYPAD_AND_ENCODER=n
CONFIG_LV_USE_DEMO_BENCHMARK=n
CONFIG_LV_USE_DEMO_STRESS=n
CONFIG_LV_USE_DEMO_MUSIC=n
CONFIG_PM_ENABLE=y
CONFIG_FREERTOS_USE_TICKLESS_IDLE=y
CONFIG_PARTITION_TABLE_CUSTOM=y
CONFIG_PARTITION_TABLE_CUSTOM_FILENAME="partitions.csv"
CONFIG_BOOTLOADER_APP_ROLLBACK_ENABLE=y
CONFIG_ESP_COREDUMP_ENABLE_TO_FLASH=y
CONFIG_ESP_COREDUMP_DATA_FORMAT_ELF=y
CONFIG_ESP_COREDUMP_CHECKSUM_CRC32=y
CONFIG_ESP_COREDUMP_CHECK_BOOT=n
CONFIG_LV_MEM_CUSTOM=y
CONFIG_LV_USE_FS_STDIO=y
CONFIG_LV_FS_STDIO_LETTER=83
CONFIG_LV_FS_STDIO_PATH="/sdcard"
CONFIG_LV_USE_PNG=y
CONFIG_MBEDTLS_HARDWARE_MPI=n
CONFIG_ESP_CONSOLE_USB_SERIAL_JTAG=y
CONFIG_ESP_CONSOLE_SECONDARY_NONE=y
CONFIG_FATFS_LFN_HEAP=y
CONFIG_FATFS_MAX_LFN=64
```
